## kernel/lsm/elfverify/Kconfig
```kconfig
config SECURITY_ELFVERIFY
       bool "elfverify support"
       depends on SECURITY
       depends on NET
       select SECURITYFS
       select SECURITY_PATH
       select SECURITY_NETWORK
       default y
       help
        This selects an elf verify for process invaking and volume mount/umount.
```

## kernel/lsm/monitor/Kconfig
```kconfig
config SECURITY_MONITOR
       bool "monitor support"
       depends on SECURITY
       depends on NET
       select SECURITYFS
       select SECURITY_PATH
       select SECURITY_NETWORK
       select SRCU
       select BUILD_BIN2C
       default y
       help
        This selects a monitor for process invaking and volume mount/umount.
```
